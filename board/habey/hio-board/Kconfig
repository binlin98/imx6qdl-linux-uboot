## board/habey/hio-board/Kconfig
```kconfig
if TARGET_HIOBOARD6X

config SYS_BOARD
	default "hio-board"

config SYS_VENDOR
	default "habey"

config SYS_SOC
    default "mx6"

config SYS_CONFIG_NAME
	default "hio-imx6dl-board"
 
endif
```

## configs/hio-imx6dl-board_defconfig
```kconfig
CONFIG_SYS_EXTRA_OPTIONS="IMX_CONFIG=board/habey/hio-board/mx6q_4x_mt41j128.cfg,MX6Q,SYS_USE_SPINOR"
CONFIG_ARM=y
CONFIG_TARGET_HIOBOARD6X=y
CONFIG_SYS_MALLOC_F=y
CONFIG_SYS_MALLOC_F_LEN=0x400
CONFIG_DM=y
CONFIG_DM_THERMAL=y
```
